## lib/reg_store/Kconfig
```kconfig
# SPDX-License-Identifier: Apache-2.0

config REG_STORE
	bool "Central register store"
	help
	  Provides a flat, ISR-safe backing store for all protocol register
	  values (input and holding banks).  Modules publish into the store;
	  Modbus and other adapters read from it.  Selected automatically by
	  VC_RUNTIME and SYS_STATUS.
```

## lib/shell_adapter/Kconfig
```kconfig
# SPDX-License-Identifier: Apache-2.0

config VC_SHELL
	bool "Zephyr shell adapter for voltage-control"
	default n
	depends on VC_RUNTIME
	select SHELL
	select SHELL_BACKEND_SERIAL
	help
	  Enable interactive shell commands under the "vc" top-level
	  command for controlling and monitoring the voltage-control
	  system.

if VC_SHELL

config VC_SHELL_WATCH_DEFAULT_INTERVAL_MS
	int "Default watch interval (ms)"
	default 500
	range 100 10000
	help
	  Default polling interval in milliseconds for the vc watch command.

endif # VC_SHELL
```
