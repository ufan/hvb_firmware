## Kconfig
```kconfig
# SPDX-License-Identifier: Apache-2.0

menu "HVB firmware shared code"

rsource "drivers/Kconfig"

endmenu
```

## boards/jianwei/jw_hvb/Kconfig.defconfig
```kconfig
if BOARD_JW_HVB

config BOARD
	default "jw_hvb"

config HVB_VC_CHANNEL
	default y

config SENSOR
	default y

config SYS_STATUS
	default y

config VC_VARIANT_ID
	default 1

config VC_DEFAULT_MEASURED_V_CAL_K
	default 2387

config VC_DEFAULT_MEASURED_I_CAL_K
	default 14901

endif # BOARD_JW_HVB
```

## boards/jianwei/jw_lvb/Kconfig.defconfig
```kconfig
if BOARD_JW_LVB

config BOARD
	default "jw_lvb"

config LVB_VC_CHANNEL
	default y

config VC_VARIANT_ID
	default 2

# LVB channels drive real loads at amp scale, not the nA-scale sense currents
# jw_hvb measures — the default 0.1nA/LSB unit can only represent up to
# 3.2768uA in an int16, nowhere near enough. 1mA/LSB (+-32.767A range) fits
# this board's real currents (a few amps at most) with much finer
# resolution than the coarser 0.1A/LSB (100mA/LSB) this used to default to.
config VC_CURRENT_UNIT_EXP
	default -3

# All 10 channels are fixed-voltage (no DAC); the reference firmware drives
# every channel active at boot, individually switchable afterward except
# channel 1 (locked always-on, see jw_lvb.dts vc_ch0's capabilities).
config VC_DEFAULT_OUTPUT_ENABLED
	default y

# Needed for the above to take effect at boot: the AUTOMATIC-mode invariant
# (which honors VC_DEFAULT_OUTPUT_ENABLED for fixed-voltage channels) only
# runs on a detected mode transition, so the board must default into
# AUTOMATIC rather than NORMAL.
config VC_DEFAULT_OPERATING_MODE
	default 1

# Voltage sampling note in the schematic marks the channel divider/isolated
# amplifier path as IN 12V -> OUT 2.14V. With a 12-bit STM32 ADC referenced to
# VDDA ~= 3.3V, 2.14V is ~2656 counts. The voltage register unit is fixed at
# 0.1V/LSB, so 12V must report 120 LSB: 120/2656 = 0.045177 LSB/count.
# Real per-unit calibration supersedes this factory nominal once run.
config VC_DEFAULT_MEASURED_V_CAL_K
	default 45177

config VC_DEFAULT_MEASURED_V_CAL_K_EXP
	default -6

# Current measurement uses ACS712-20A sensitivity (100mV/A), then the
# schematic's equal 20K/20K R3/R2 network halves the signal before the
# RS8412XK buffer. Effective ADC sensitivity is therefore ~50mV/A. One ADC
# count is 3.3V/4096 = 0.8057mV, so one amp is ~62.06 counts. With
# VC_CURRENT_UNIT_EXP=-3 (1mA/LSB), the register gain is
# 1000/62.06 = 16.113 LSB/count — same mantissa as the old 0.1A/LSB gain
# (0.16113 LSB/count), just moved two decades by K_EXP since only the
# *declared* register unit changed, not the physical ADC calibration.
config VC_DEFAULT_MEASURED_I_CAL_K
	default 16113

config VC_DEFAULT_MEASURED_I_CAL_K_EXP
	default -3

# At the register gain above (16.113 mA/LSB), even modest ADC jitter reads
# out as a large current swing — the generic driver default of 5 samples
# (150ms report period) let no-load current jump by several hundred mA
# between reports. 16 samples (~480ms) helped but some channels still
# showed report-to-report stdev up to ~160mA on real hardware.
#
# Oversampling noise falls off as 1/sqrt(N), so from a measured N=16
# baseline (stdev per channel 21-159mA across 10 channels) the expected
# stdev at other N is baseline x sqrt(16/N). Budgeting a <2s report
# period caps N at ~66 (66 x 30ms sample tick = 1980ms); N=64 lands just
# under that with margin (1920ms) and roughly halves the N=16 noise
# (predicted 10-80mA range) — worth it since AUTOMATIC-mode protection
# response time isn't documented as needing to be faster than ~2s on
# this board. Confirm the halving actually held on real hardware before
# trusting this comment; the 1/sqrt(N) model assumes i.i.d. sample
# noise, which is an approximation, not a guarantee.
config LVB_VC_OVERSAMPLE_COUNT
	default 64

# The generic VC_DEFAULT_CURRENT_LIMIT default (10000) is sized for
# jw_hvb's nA-scale unit — reused as-is on jw_lvb's 1 mA/LSB unit it would
# mean 10000 mA (10 A), not a sane per-channel limit for this board's real
# loads. 6000 = 6000 mA (6 A).
config VC_DEFAULT_CURRENT_LIMIT
	default 6000

endif # BOARD_JW_LVB
```

## boards/jianwei/jw_lvb/jw_lvb_defconfig
```kconfig
CONFIG_CLOCK_CONTROL=y
CONFIG_PINCTRL=y
CONFIG_GPIO=y
CONFIG_SERIAL=y
CONFIG_WATCHDOG=y
```

## drivers/Kconfig
```kconfig
# SPDX-License-Identifier: Apache-2.0

rsource "dac/ad5541/Kconfig"
rsource "sensor/ads1232/Kconfig"
rsource "voltage_control/Kconfig"
```

## drivers/dac/ad5541/Kconfig
```kconfig
# SPDX-License-Identifier: Apache-2.0

config AD5541
	bool "AD5541 16-bit SPI DAC driver"
	default y
	depends on DT_HAS_ADI_AD5541_ENABLED
	select SPI
	help
	  Enable the AD5541 16-bit write-only SPI DAC driver.
```

## drivers/sensor/ads1232/Kconfig
```kconfig
# SPDX-License-Identifier: Apache-2.0
# Copyright (c) 2026 Jianwei

config ADS1232
	bool "ADS1232 24-bit delta-sigma ADC driver"
	default y
	depends on DT_HAS_TI_ADS1232_ENABLED
	select ADC
	help
	  Enable the TI ADS1232 24-bit delta-sigma ADC driver.
	  Uses GPIO bit-bang protocol (not SPI).

config ADS1232_INTERRUPT_DRIVEN
	bool "Use interrupt-driven DRDY wait for ADS1232"
	depends on ADS1232
	select ADC_ASYNC
	help
	  Use GPIO interrupt on DRDY pin instead of polling.
	  Enables adc_read_async() for non-blocking ADC reads.
	  The ISR performs the 24-bit bit-bang (~50us) and signals
	  the caller via k_poll_signal.
```

## drivers/voltage_control/Kconfig
```kconfig
# SPDX-License-Identifier: Apache-2.0

rsource "hvb_vc_channel/Kconfig"
rsource "lvb_vc_channel/Kconfig"
```

## drivers/voltage_control/hvb_vc_channel/Kconfig
```kconfig
# SPDX-License-Identifier: Apache-2.0

config HVB_VC_CHANNEL
	bool "HVB virtual voltage channel provider"
	default y
	depends on DT_HAS_JIANWEI_HVB_VC_CHANNEL_ENABLED
	select ADS1232_INTERRUPT_DRIVEN
	help
	  Virtual voltage channel provider for Jianwei HVB boards.
	  Uses interrupt-driven ADC reads via adc_read_async().
```

## drivers/voltage_control/lvb_vc_channel/Kconfig
```kconfig
# SPDX-License-Identifier: Apache-2.0

config LVB_VC_CHANNEL
	bool "LVB virtual voltage channel provider"
	default y
	depends on DT_HAS_JIANWEI_LVB_VC_CHANNEL_ENABLED
	select ADC_STM32
	help
	  Virtual voltage channel provider for Jianwei LVB boards.
	  Uses synchronous ADC reads via adc_read_dt() with software
	  oversampling for noise reduction.

config LVB_VC_DEFAULT_SAMPLE_RATE_MS
	int "LVB ADC sample interval in milliseconds (per-sample timer period)"
	default 30
	range 1 1000
	depends on LVB_VC_CHANNEL
	help
	  Timer period for one ADC acquisition per channel.  The effective
	  measurement report period is this value multiplied by
	  LVB_VC_OVERSAMPLE_COUNT (default: 30 ms x 5 = 150 ms).
	  Can be overridden per-channel via the sample-rate-ms DTS property.

config LVB_VC_OVERSAMPLE_COUNT
	int "LVB ADC oversampling count (samples averaged before one report)"
	default 5
	range 1 100
	depends on LVB_VC_CHANNEL
	help
	  Number of raw ADC samples averaged together before a single
	  measurement result is published to the vc_channel framework.
	  Averaging noise falls off as 1/sqrt(N), so doubling this roughly
	  halves report-to-report jitter at the cost of doubling the report
	  period (this value x LVB_VC_DEFAULT_SAMPLE_RATE_MS) — weigh against
	  how fast a board needs its protection logic to react. Range raised
	  from the original 20 to 100 to give boards with a noisier current
	  front-end (e.g. jw_lvb) room to trade report latency for a materially
	  quieter reading; a board with tighter timing needs should just use a
	  lower value, not rely on the range cap for that.
	  Can be overridden per-channel via the oversample-count DTS property.
```

## dts/bindings/dac/adi,ad5541.yaml
```yaml
# Copyright (c) 2026 Jianwei
# SPDX-License-Identifier: Apache-2.0

description: AD5541 16-bit SPI DAC (write-only)

compatible: "adi,ad5541"

include: [base.yaml, spi-device.yaml]

properties:
  vref-mv:
    type: int
    default: 5000
    description: Reference voltage in mV
```

## dts/bindings/sensor/ti,ads1232.yaml
```yaml
# Copyright (c) 2026 Jianwei
# SPDX-License-Identifier: Apache-2.0

description: TI ADS1232 24-bit Delta-Sigma ADC

compatible: "ti,ads1232"

include: [base.yaml]

properties:
  drdy-gpios:
    type: phandle-array
    required: true
    description: Data ready / data out pin

  sclk-gpios:
    type: phandle-array
    required: true
    description: Serial clock output

  pwdn-gpios:
    type: phandle-array
    required: true
    description: Power down / chip select (active low)

  a0-gpios:
    type: phandle-array
    required: false
    description: Channel select A0

  a1-gpios:
    type: phandle-array
    required: false
    description: Channel select A1

  gain0-gpios:
    type: phandle-array
    required: false
    description: PGA gain select GAIN0

  gain1-gpios:
    type: phandle-array
    required: false
    description: PGA gain select GAIN1

  gain:
    type: int
    required: true
    enum: [1, 2]
    description: PGA gain multiplier applied at init.

  runtime-gain:
    type: boolean
    description: |
      Allow PGA gain to be changed at runtime via adc_channel_setup().
      When absent, gain is fixed at the value of the gain property and
      adc_channel_setup() ignores the gain field.
```

## dts/bindings/voltage_control/jianwei,hvb-vc-channel.yaml
```yaml
# Copyright (c) 2026 Jianwei
# SPDX-License-Identifier: Apache-2.0

description: HVB Virtual Voltage Channel (child of vc-controller)

compatible: "jianwei,hvb-vc-channel"

properties:
  reg:
    type: array
    required: true
    description: Channel index (0-based).
  label:
    type: string
    required: true
    description: Human-readable channel name.
  capabilities:
    type: int
    required: true
    description: Bitmask of CH_CAP_* flags.
  enable-gpios:
    type: phandle-array
    required: false
    description: GPIO that gates channel output.
  dac:
    type: phandle
    required: true
    description: Phandle to the DAC device.
  adc:
    type: phandle
    required: false
    description: Phandle to the ADC device. Required only when V or I measurement capability is enabled.
  max-raw-dac:
    type: int
    required: true
    default: 0xFFFF
    description: Maximum raw DAC code.
```

## dts/bindings/voltage_control/jianwei,lvb-vc-channel.yaml
```yaml
# Copyright (c) 2026 Jianwei
# SPDX-License-Identifier: Apache-2.0

description: LVB Virtual Voltage Channel (child of vc-controller)

compatible: "jianwei,lvb-vc-channel"

properties:
  reg:
    type: array
    required: true
    description: Channel index (0-based).
  label:
    type: string
    required: true
    description: Human-readable channel name.
  capabilities:
    type: int
    required: true
    description: Bitmask of CH_CAP_* flags.
  enable-gpios:
    type: phandle-array
    required: true
    description: GPIO that enables channel output (active-high).
  io-channels:
    type: phandle-array
    required: true
    description: ADC channel references; must match io-channel-names order.
  io-channel-names:
    type: string-array
    required: true
    description: Must contain "voltage" and "current" (in that order).
  calib-current-b:
    type: int
    required: false
    default: 0
    description: >
      Initial value for measured_current_calib_b (int16_t). Represents the
      ADC reading at zero current (negated: if zero-current raw = 1822,
      set -1822). Loaded as the channel's default measured_current_calib_b
      at first boot; can be refined via the calibration workflow.
  sample-rate-ms:
    type: int
    required: false
    description: >
      Per-sample timer interval in ms. Overrides
      CONFIG_LVB_VC_DEFAULT_SAMPLE_RATE_MS for this specific channel.
  oversample-count:
    type: int
    required: false
    description: >
      Number of ADC samples averaged before one measurement is reported.
      Overrides CONFIG_LVB_VC_OVERSAMPLE_COUNT for this specific channel.
  default-output-disabled:
    type: boolean
    description: >
      Set to start this channel's configured_output_enabled factory
      default as false instead of the normal CONFIG_VC_DEFAULT_OUTPUT_ENABLED
      value. Absent (the common case) means this channel follows the global
      Kconfig default like every other channel — this property only exists
      to mark the exceptions. Only meaningful on channels with
      CH_CAP_OUTPUT_ENABLE (switchable channels); silently has no effect on
      a locked always-on channel, since configured_output_enabled isn't a
      supported register there regardless of its stored value.
```

## dts/bindings/voltage_control/jianwei,vc-channel-base.yaml
```yaml
# Copyright (c) 2026 Jianwei
# SPDX-License-Identifier: Apache-2.0

description: Virtual Channel base node — per-channel hardware capabilities

compatible: "jianwei,vc-channel-base"

include: base.yaml

properties:
  channel-index:
    type: int
    required: true
    description: |
      Zero-based channel index. Must match the position in the
      controller's channels phandle array.

  capabilities:
    type: int
    required: true
    description: |
      Bitmask of CH_CAP_* flags. Static board-design facts;
      not runtime-selectable.

  enable-gpios:
    type: phandle-array
    required: true
    description: |
      GPIO that gates channel output. Mandatory because on/off is
      the minimum virtual channel capability.
```

## dts/bindings/voltage_control/jianwei,vc-channel-stub.yaml
```yaml
# Copyright (c) 2026 Jianwei
# SPDX-License-Identifier: Apache-2.0

description: Stub VC channel for native_posix tests (child of vc-controller)

compatible: "jianwei,vc-channel-stub"

properties:
  reg:
    type: array
    required: true
    description: Channel index (0-based).
  label:
    type: string
    required: true
    description: Human-readable channel name.
  capabilities:
    type: int
    required: true
    description: Bitmask of CH_CAP_* flags.
```

## dts/bindings/voltage_control/jianwei,vc-controller.yaml
```yaml
# Copyright (c) 2026 Jianwei
# SPDX-License-Identifier: Apache-2.0

description: Voltage controller — owns virtual channels as children

compatible: "jianwei,vc-controller"

include: base.yaml

properties:
  "#address-cells":
    type: int
    const: 1
  "#size-cells":
    type: int
    const: 0

child-binding:
  description: Virtual voltage channel base properties
  properties:
    reg:
      type: array
      required: true
      description: Channel index (0-based).
    label:
      type: string
      required: true
      description: Human-readable channel name.
    capabilities:
      type: int
      required: true
      description: Bitmask of CH_CAP_* flags.
    enable-gpios:
      type: phandle-array
      required: false
      description: GPIO that gates channel output.
```

## lib/Kconfig
```kconfig
# SPDX-License-Identifier: Apache-2.0

rsource "reg_store/Kconfig"
rsource "voltage_control/Kconfig"
rsource "sys_status/Kconfig"
rsource "modbus_adapter/Kconfig"
```

## lib/modbus_adapter/Kconfig
```kconfig
# SPDX-License-Identifier: Apache-2.0

config UI_MODBUS_RTU
	bool "Modbus RTU UI adapter"
	default n
	depends on MODBUS && VC_RUNTIME && VC_CHANNEL_CONTROLLER
	select REBOOT
	select SYS_RESET
	help
	  Enable Modbus RTU as the user interface adapter for the
	  voltage-control system.

if UI_MODBUS_RTU

config VC_MODBUS_UNIT_ID
	int "Modbus server unit ID"
	default 1
	range 1 247
	help
	  Modbus RTU slave address for the voltage-control server.

config VC_MODBUS_BAUD_RATE
	int "Modbus baud rate"
	default 115200
	help
	  Baud rate for the Modbus RTU serial interface.

config MODBUS_ADAPTER_SHELL
	bool "Shell commands for Modbus adapter"
	default n
	select SHELL
	help
	  Enable "mb" shell command tree for Modbus slave address
	  and baud rate configuration.

endif # UI_MODBUS_RTU
```
