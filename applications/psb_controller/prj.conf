## CMakeLists.txt
```
# SPDX-License-Identifier: Apache-2.0

cmake_minimum_required(VERSION 3.20.0)

get_filename_component(HVB_FIRMWARE_ROOT ${CMAKE_CURRENT_SOURCE_DIR}/../.. ABSOLUTE)
list(APPEND ZEPHYR_EXTRA_MODULES ${HVB_FIRMWARE_ROOT})

find_package(Zephyr REQUIRED HINTS $ENV{ZEPHYR_BASE})
project(psb_controller)

target_include_directories(app PRIVATE
	${CMAKE_CURRENT_SOURCE_DIR}/../../include
)

target_sources(app PRIVATE
	src/main.c
)
```

## prj.conf
```kconfig
# ---- Generic system ----
CONFIG_GPIO=y
CONFIG_SERIAL=y
CONFIG_UART_INTERRUPT_DRIVEN=y
CONFIG_CONSOLE=y
CONFIG_UART_CONSOLE=y
CONFIG_PRINTK=y
CONFIG_LOG=y
CONFIG_LOG_MODE_IMMEDIATE=y
CONFIG_LOG_CMDS=y

# ---- Modbus RTU frontend ----
CONFIG_MODBUS=y
CONFIG_MODBUS_ROLE_SERVER=y
CONFIG_UI_MODBUS_RTU=y

# Suppress protocol-exception INFO logs (e.g. "FC 0x04 Error 0x02" on
# absent channels). Use _ERR for error-only, _WRN for warning+error.
# Default is _INF — useful for development, noise for production.
CONFIG_MODBUS_LOG_LEVEL_WRN=y

# ---- Shell ----
CONFIG_VC_SHELL=y
CONFIG_MODBUS_ADAPTER_SHELL=y
# independent of CONFIG_SYS_STATUS — always shows uptime/fw version,
# plus temp/humidity on boards that also enable CONFIG_SYS_STATUS
CONFIG_SYS_STATUS_SHELL=y

# ---- ADC (both boards have ADCs; exact driver auto-selected via DTS) ----
CONFIG_ADC=y

# ---- Voltage-control framework (channel config from DTS) ----
# Board-specific channel driver (HVB_VC_CHANNEL / LVB_VC_CHANNEL)
# auto-enables via DT_HAS_*_ENABLED gated by Kconfig.defconfig.
CONFIG_VC_CHANNEL_CONTROLLER=y
CONFIG_VC_RUNTIME=y
CONFIG_VC_SETTINGS_PERSISTENCE=y

# ---- System reset ----
CONFIG_REBOOT=y
CONFIG_SYS_RESET=y
```

## boards/jw_lvb.conf
```kconfig
# jw_lvb has no accessible debug UART — route console/shell over Segger RTT
# instead of the generic UART console this app assumes by default.
CONFIG_UART_CONSOLE=n
CONFIG_USE_SEGGER_RTT=y
CONFIG_RTT_CONSOLE=y
CONFIG_SHELL_BACKEND_RTT=y
```

## src/main.c
```c
/*
 * Copyright (c) 2026 Jianwei
 *
 * SPDX-License-Identifier: Apache-2.0
 */

#include <zephyr/kernel.h>
#include <zephyr/sys/printk.h>

#include "voltage_control/vc.h"

#if IS_ENABLED(CONFIG_UI_MODBUS_RTU)
#include "modbus_adapter/modbus_adapter.h"
#endif

#if IS_ENABLED(CONFIG_VC_SHELL)
#include "voltage_control/vc_shell.h"
#endif

int main(void)
{
	struct vc_ctx *ctx = vc_init();

	if (!ctx) {
		printk("Failed to init vc\n");
		return 0;
	}

	int ret = vc_ctx_start(ctx);

	if (ret != VC_OK) {
		printk("Failed to start vc: %d\n", ret);
		return 0;
	}

#if IS_ENABLED(CONFIG_UI_MODBUS_RTU)
	ret = modbus_adapter_init();
	if (ret < 0) {
		return 0;
	}
#endif

#if IS_ENABLED(CONFIG_VC_SHELL)
	vc_shell_init();
#endif

	printk("psb_controller ready\n");
	return 0;
}
```
