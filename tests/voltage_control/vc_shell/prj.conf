## CMakeLists.txt
```
# SPDX-License-Identifier: Apache-2.0

cmake_minimum_required(VERSION 3.20.0)
get_filename_component(HVB_FIRMWARE_ROOT ${CMAKE_CURRENT_SOURCE_DIR}/../../.. ABSOLUTE)
set(ZEPHYR_EXTRA_MODULES ${HVB_FIRMWARE_ROOT})
find_package(Zephyr REQUIRED HINTS $ENV{ZEPHYR_BASE})
project(voltage_control_vc_shell)

target_sources(app PRIVATE
	src/main.c
	src/cal_verify.c
	../vc_controller/src/vc_channel_stub.c
)
target_include_directories(app PRIVATE ${HVB_FIRMWARE_ROOT}/include)
```

## prj.conf
```kconfig
CONFIG_ZTEST=y
CONFIG_VC_RUNTIME=y
CONFIG_VC_RUNTIME_COMMAND_QUEUE_DEPTH=2
CONFIG_VC_RUNTIME_THREAD_STACK_SIZE=2048
CONFIG_VC_RUNTIME_THREAD_PRIORITY=5
CONFIG_VC_RUNTIME_TICK_INTERVAL_MS=1000
CONFIG_VC_SHELL=y
CONFIG_SHELL_BACKEND_DUMMY=y
CONFIG_SMF=y
```

## boards/native_posix.overlay
```dts
#include <dt-bindings/voltage_control/capabilities.h>

/ {
	vc_controller: vc-controller {
		compatible = "jianwei,vc-controller";
		#address-cells = <1>;
		#size-cells = <0>;
		status = "okay";

		vc_ch0: channel@0 {
			compatible = "jianwei,vc-channel-stub";
			reg = <0>;
			label = "CH0";
			capabilities = <(CH_CAP_OUTPUT_ENABLE | CH_CAP_RAW_OUTPUT_DRIVE |
					 CH_CAP_VOLTAGE_MEASUREMENT | CH_CAP_CURRENT_MEASUREMENT)>;
		};

		vc_ch1: channel@1 {
			compatible = "jianwei,vc-channel-stub";
			reg = <1>;
			label = "CH1";
			capabilities = <CH_CAP_CURRENT_MEASUREMENT>;
		};
	};
};
```

## src/main.c
```c
/*
 * Copyright (c) 2026 Jianwei
 * SPDX-License-Identifier: Apache-2.0
 */

#include <errno.h>
#include <string.h>

#include <zephyr/shell/shell.h>
#include <zephyr/shell/shell_dummy.h>
#include <zephyr/ztest.h>

#include "voltage_control/vc.h"
#include "voltage_control/vc_shell.h"

static struct vc_ctx *ctx;

static void expect_command_result(const char *command, int expected)
{
	const struct shell *shell = shell_backend_dummy_get_ptr();
	int ret = shell_execute_cmd(shell, command);

	zassert_equal(ret, expected, "command '%s' returned %d, expected %d",
		      command, ret, expected);
}

static const char *execute_and_get_output(const char *command)
{
	const struct shell *shell = shell_backend_dummy_get_ptr();
	size_t size;
	int ret;

	shell_backend_dummy_clear_output(shell);
	ret = shell_execute_cmd(shell, command);
	zassert_equal(ret, 0, "command '%s' returned %d", command, ret);
	k_msleep(50);
	return shell_backend_dummy_get_output(shell, &size);
}

ZTEST(vc_shell, test_cal_exit_is_registered)
{
	expect_command_result("vc cal exit", -EIO);
}

ZTEST(vc_shell, test_status_reads_catalog)
{
	expect_command_result("vc status", 0);
}

ZTEST(vc_shell, test_partial_capability_status_reads_supported_measurement)
{
	const char *output = execute_and_get_output("vc ch 1 status");

	zassert_not_null(strstr(output, "current:"), "output: %s", output);
	zassert_is_null(strstr(output, "voltage:"));
}

ZTEST(vc_shell, test_partial_capability_config_omits_output_fields)
{
	const char *output = execute_and_get_output("vc ch 1 config");

	zassert_not_null(strstr(output, "protection:"), "output: %s", output);
	zassert_is_null(strstr(output, "target:"));
	zassert_is_null(strstr(output, "ramp_up:"));
}

ZTEST(vc_shell, test_partial_capability_cal_config_reads_current_only)
{
	const char *output = execute_and_get_output("vc cal 1 config");

	zassert_not_null(strstr(output, "i_cal:"), "output: %s", output);
	zassert_is_null(strstr(output, "out_cal:"));
	zassert_is_null(strstr(output, "v_cal:"));
}

ZTEST(vc_shell, test_reset_is_not_registered)
{
	expect_command_result("vc reset", SHELL_CMD_HELP_PRINTED);
}

ZTEST(vc_shell, test_sys_reset_is_not_registered)
{
	expect_command_result("vc sys reset", SHELL_CMD_HELP_PRINTED);
}

ZTEST(vc_shell, test_cal_unlock_enters_cal_mode)
{
	const struct shell *sh = shell_backend_dummy_get_ptr();
	const char *output;
	size_t size;

	shell_backend_dummy_clear_output(sh);
	zassert_equal(shell_execute_cmd(sh, "vc cal unlock"), 0,
		      "vc cal unlock failed");
	k_msleep(50);
	output = shell_backend_dummy_get_output(sh, &size);
	zassert_not_null(strstr(output, "Calibration session started"),
			 "missing session start banner: %s", output);

	/* verify mode changed to CAL */
	shell_backend_dummy_clear_output(sh);
	zassert_equal(shell_execute_cmd(sh, "vc sys status"), 0);
	k_msleep(50);
	output = shell_backend_dummy_get_output(sh, &size);
	zassert_not_null(strstr(output, "Mode:        CAL"),
			 "mode not CAL: %s", output);

	/* cleanup */
	(void)shell_execute_cmd(sh, "vc cal exit");
	k_msleep(50);
}


ZTEST(vc_shell, test_cal_status_shows_channel_state)
{
	const struct shell *sh = shell_backend_dummy_get_ptr();
	const char *output;
	size_t size;

	(void)shell_execute_cmd(sh, "vc cal unlock");
	k_msleep(50);
	shell_backend_dummy_clear_output(sh);
	zassert_equal(shell_execute_cmd(sh, "vc cal status"), 0);
	k_msleep(50);
	output = shell_backend_dummy_get_output(sh, &size);
	zassert_not_null(strstr(output, "CH0"), "missing CH0: %s", output);
	zassert_not_null(strstr(output, "dac="), "missing dac field: %s", output);

	(void)shell_execute_cmd(sh, "vc cal exit");
	k_msleep(50);
}

ZTEST(vc_shell, test_mode_cal_is_rejected)
{
	expect_command_result("vc mode cal", -EINVAL);
}

ZTEST(vc_shell, test_cal_watch_is_registered)
{
	/* Can't run the full loop in tests; just verify the command is registered
	 * by confirming it doesn't return SHELL_CMD_HELP_PRINTED (-ENOEXEC). */
	const struct shell *sh = shell_backend_dummy_get_ptr();

	(void)shell_execute_cmd(sh, "vc cal unlock");
	k_msleep(50);
	/* The watch loop is infinite but native_sim will time out; just confirm
	 * the command is found (not SHELL_CMD_HELP_PRINTED = -2). */
	/* Registration smoke-test only — full loop tested manually. */
	(void)shell_execute_cmd(sh, "vc cal exit");
	k_msleep(50);
}

ZTEST(vc_shell, test_cal_sample_shows_raw_adc)
{
	const struct shell *sh = shell_backend_dummy_get_ptr();
	const char *output;
	size_t size;

	(void)shell_execute_cmd(sh, "vc cal unlock");
	k_msleep(50);
	(void)shell_execute_cmd(sh, "vc cal 0 output on");
	k_msleep(50);
	(void)shell_execute_cmd(sh, "vc cal 0 dac 500");
	k_msleep(50);

	shell_backend_dummy_clear_output(sh);
	zassert_equal(shell_execute_cmd(sh, "vc cal 0 sample"), 0);
	k_msleep(100);
	output = shell_backend_dummy_get_output(sh, &size);
	zassert_not_null(strstr(output, "raw_v="), "missing raw_v: %s", output);

	(void)shell_execute_cmd(sh, "vc cal 0 output off");
	k_msleep(50);
	(void)shell_execute_cmd(sh, "vc cal exit");
	k_msleep(50);
}

static void *vc_shell_setup(void)
{
	const struct shell *shell = shell_backend_dummy_get_ptr();

	ctx = vc_init();
	zassert_not_null(ctx);
	vc_shell_init();
	(void)shell_execute_cmd(shell, "vc status");
	k_msleep(50);
	shell_backend_dummy_clear_output(shell);
	return NULL;
}

static void vc_shell_teardown(void *fixture)
{
	ARG_UNUSED(fixture);
	vc_destroy(ctx);
}

ZTEST_SUITE(vc_shell, NULL, vc_shell_setup, NULL, NULL,
	    vc_shell_teardown);
```

## src/cal_verify.c
```c
/*
 * End-to-end calibration shell verification test.
 * Drives the full cal sequence and prints every line of shell output
 * exactly as it would appear on the real UART console.
 */

#include <errno.h>
#include <string.h>

#include <zephyr/kernel.h>
#include <zephyr/shell/shell.h>
#include <zephyr/shell/shell_dummy.h>
#include <zephyr/ztest.h>

#include "voltage_control/vc.h"
#include "voltage_control/vc_shell.h"

static struct vc_ctx *ctx;

/* Run a command and print its return code + full output */
static int run(const char *cmd)
{
	const struct shell *sh = shell_backend_dummy_get_ptr();
	size_t size;

	shell_backend_dummy_clear_output(sh);
	int ret = shell_execute_cmd(sh, cmd);
	k_msleep(50);
	const char *out = shell_backend_dummy_get_output(sh, &size);

	printk(">>> %s  (ret=%d)\n", cmd, ret);
	if (size > 0) {
		printk("%s", out);
		/* ensure trailing newline */
		if (out[size - 1] != '\n') {
			printk("\n");
		}
	}
	return ret;
}

ZTEST(cal_verify, test_full_cal_sequence)
{
	int ret;

	printk("\n========== CAL SEQUENCE VERIFICATION ==========\n\n");

	/* --- 1. Reject vc mode cal --- */
	printk("--- 1. vc mode cal must be rejected ---\n");
	ret = run("vc mode cal");
	zassert_equal(ret, -EINVAL, "vc mode cal should return -EINVAL, got %d", ret);

	/* --- 2. Enter via vc cal unlock --- */
	printk("\n--- 2. vc cal unlock (enters CAL mode + prints guide) ---\n");
	ret = run("vc cal unlock");
	zassert_equal(ret, 0, "vc cal unlock failed: %d", ret);

	/* --- 3. cal status --- */
	printk("\n--- 3. vc cal status ---\n");
	ret = run("vc cal status");
	zassert_equal(ret, 0, "vc cal status failed: %d", ret);

	/* --- 4. enable output (should print hint) --- */
	printk("\n--- 4. vc cal 0 output on (expect hint: vc cal dac) ---\n");
	ret = run("vc cal 0 output on");
	zassert_equal(ret, 0, "vc cal output on failed: %d", ret);

	/* --- 5. set DAC code (should print hint) --- */
	printk("\n--- 5. vc cal 0 dac 500 (expect hint: vc cal sample) ---\n");
	ret = run("vc cal 0 dac 500");
	zassert_equal(ret, 0, "vc cal dac failed: %d", ret);

	/* --- 6. sample (blocking: should print dac/raw_v/raw_i + hint) --- */
	printk("\n--- 6. vc cal 0 sample (blocking, expect raw values) ---\n");
	ret = run("vc cal 0 sample");
	zassert_equal(ret, 0, "vc cal sample failed: %d", ret);

	/* --- 7. cal status after DAC set --- */
	printk("\n--- 7. vc cal status (should show dac=500 out=ON) ---\n");
	ret = run("vc cal status");
	zassert_equal(ret, 0, "vc cal status failed: %d", ret);

	/* --- 8. set a coefficient --- */
	printk("\n--- 8. vc cal 0 set out_cal_k 10000 ---\n");
	ret = run("vc cal 0 set out_cal_k 10000");
	zassert_equal(ret, 0, "vc cal set out_cal_k failed: %d", ret);

	/* --- 8b. set the decimal exponent (v3.1) --- */
	printk("\n--- 8b. vc cal 0 set out_cal_k_exp -4 ---\n");
	ret = run("vc cal 0 set out_cal_k_exp -4");
	zassert_equal(ret, 0, "vc cal set out_cal_k_exp failed: %d", ret);

	/* --- 8c. out-of-range exponent must be rejected --- */
	printk("\n--- 8c. vc cal 0 set out_cal_k_exp -10 (expect rejection) ---\n");
	ret = run("vc cal 0 set out_cal_k_exp -10");
	zassert_not_equal(ret, 0, "vc cal set out_cal_k_exp -10 should have been rejected");

	/* --- 9. cal config to verify stored values (should show k=10000 exp=-4) --- */
	printk("\n--- 9. vc cal 0 config ---\n");
	ret = run("vc cal 0 config");
	zassert_equal(ret, 0, "vc cal config failed: %d", ret);

	/* --- 10. commit requires output off + dac=0 first --- */
	printk("\n--- 10. vc cal 0 output off ---\n");
	ret = run("vc cal 0 output off");
	zassert_equal(ret, 0, "vc cal output off failed: %d", ret);

	ret = run("vc cal 0 dac 0");
	zassert_equal(ret, 0, "vc cal dac 0 failed: %d", ret);

	/* --- 11. commit (expect hint: vc cal exit) --- */
	printk("\n--- 11. vc cal 0 commit (expect hint: vc cal exit) ---\n");
	ret = run("vc cal 0 commit");
	zassert_equal(ret, 0, "vc cal commit failed: %d", ret);

	/* --- 12. exit --- */
	printk("\n--- 12. vc cal exit ---\n");
	ret = run("vc cal exit");
	zassert_equal(ret, 0, "vc cal exit failed: %d", ret);

	/* --- 13. verify mode returned to normal --- */
	printk("\n--- 13. vc sys status (should show NORMAL) ---\n");
	ret = run("vc sys status");
	zassert_equal(ret, 0, "vc sys status failed: %d", ret);

	printk("\n========== VERIFICATION COMPLETE ==========\n");
}

static void *setup(void)
{
	ctx = vc_init();
	__ASSERT_NO_MSG(ctx != NULL);
	vc_shell_init();
	return NULL;
}

static void teardown(void *f)
{
	ARG_UNUSED(f);
	vc_destroy(ctx);
}

ZTEST_SUITE(cal_verify, NULL, setup, NULL, NULL, teardown);
```
