## CMakeLists.txt
```
# SPDX-License-Identifier: Apache-2.0

cmake_minimum_required(VERSION 3.20.0)
get_filename_component(HVB_FIRMWARE_ROOT ${CMAKE_CURRENT_SOURCE_DIR}/../../.. ABSOLUTE)
set(ZEPHYR_EXTRA_MODULES ${HVB_FIRMWARE_ROOT})
find_package(Zephyr REQUIRED HINTS $ENV{ZEPHYR_BASE})
project(voltage_control_vc)

FILE(GLOB app_sources src/*.c)
target_sources(app PRIVATE ${app_sources})
target_include_directories(app PRIVATE ${CMAKE_CURRENT_SOURCE_DIR}/../../../include)
```

## prj.conf
```kconfig
CONFIG_ZTEST=y
CONFIG_VC_RUNTIME=y
CONFIG_VC_RUNTIME_COMMAND_QUEUE_DEPTH=2
CONFIG_VC_RUNTIME_THREAD_STACK_SIZE=2048
CONFIG_VC_RUNTIME_THREAD_PRIORITY=5
CONFIG_VC_RUNTIME_TICK_INTERVAL_MS=1000
CONFIG_SMF=y
```

## boards/native_posix.overlay
```dts
/ {
	vc_ch0: vc-channel-0 {
		compatible = "jianwei,vc-channel-stub";
		channel-index = <0>;
		capabilities = <0x000f>;
	};
	vc_ch1: vc-channel-1 {
		compatible = "jianwei,vc-channel-stub";
		channel-index = <1>;
		capabilities = <0x000f>;
	};
	vc_controller: vc-controller {
		compatible = "jianwei,vc-controller";
		channels = <&vc_ch0 &vc_ch1>;
		status = "okay";
	};
};
```

## src/main.c
```c
/*
 * Copyright (c) 2026 Jianwei
 *
 * SPDX-License-Identifier: Apache-2.0
 */

#include <zephyr/ztest.h>

#include "reg_store/reg_catalog.h"
#include "reg_store/reg_map.h"
#include "reg_store/reg_schema.h"
#include "voltage_control/vc.h"

static struct vc_ctx *ctx;

static void write_u16(reg_id_t id, uint16_t input)
{
	union reg_value value = { .u16 = input };

	zassert_equal(reg_write(id, value, K_SECONDS(1)), REG_OK);
}

static uint16_t read_u16(reg_id_t id)
{
	union reg_value value = {};

	zassert_equal(reg_read(id, &value), REG_OK);
	return value.u16;
}

static void *suite_setup(void)
{
	ctx = vc_init();
	zassert_not_null(ctx);
	return ctx;
}

ZTEST_SUITE(vc_api, NULL, suite_setup, NULL, NULL, NULL);

ZTEST(vc_api, test_init_returns_non_null)
{
	zassert_not_null(ctx);
}

ZTEST(vc_api, test_start_returns_ok)
{
	zassert_equal(vc_ctx_start(ctx), VC_OK);
}

ZTEST(vc_api, test_catalog_sets_mode)
{
	write_u16(REG_VC_GLOBAL_ID(REG_VC_GLOBAL_FIELD_OPERATING_MODE),
		  VC_OPERATING_MODE_AUTOMATIC);

	k_msleep(50);
	zassert_equal(read_u16(REG_VC_GLOBAL_ID(
		REG_VC_GLOBAL_FIELD_ACTIVE_OPERATING_MODE)),
		VC_OPERATING_MODE_AUTOMATIC);

	write_u16(REG_VC_GLOBAL_ID(REG_VC_GLOBAL_FIELD_OPERATING_MODE),
		  VC_OPERATING_MODE_NORMAL);
}

ZTEST(vc_api, test_catalog_dispatches_output_action)
{
	write_u16(REG_VC_ID(0, REG_VC_FIELD_OUTPUT_ACTION),
		  VC_OUTPUT_ACTION_ENABLE);

	k_msleep(50);
	zassert_true(read_u16(REG_VC_ID(0, REG_VC_FIELD_STATUS_BITS)) & 0x0002);

	write_u16(REG_VC_ID(0, REG_VC_FIELD_OUTPUT_ACTION),
		  VC_OUTPUT_ACTION_DISABLE_IMMEDIATE);
}

ZTEST(vc_api, test_catalog_sets_channel_field)
{
	write_u16(REG_VC_ID(0, REG_VC_FIELD_CFG_TARGET_VOLTAGE), 5000);

	k_msleep(50);
	zassert_equal(read_u16(REG_VC_ID(0, REG_VC_FIELD_CFG_TARGET_VOLTAGE)),
		5000);
}

ZTEST(vc_api, test_catalog_sets_system_field)
{
	write_u16(REG_VC_GLOBAL_ID(
		REG_VC_GLOBAL_FIELD_STARTUP_CHANNEL_POLICY), 1);

	k_msleep(50);
	zassert_equal(read_u16(REG_VC_GLOBAL_ID(
		REG_VC_GLOBAL_FIELD_STARTUP_CHANNEL_POLICY)), 1);
}

ZTEST(vc_api, test_catalog_reads_vc_fixed_and_config_state)
{
	union reg_value value = {};
	write_u16(REG_VC_ID(0, REG_VC_FIELD_CFG_TARGET_VOLTAGE), 5000);

	zassert_equal(reg_read(REG_MODBUS_ID(REG_MODBUS_FIELD_PROTOCOL_MAJOR), &value),
		      REG_OK);
	zassert_equal(value.u16, VC_PROTOCOL_MAJOR);
	zassert_equal(reg_read(REG_VC_GLOBAL_ID(
			       REG_VC_GLOBAL_FIELD_SUPPORTED_CHANNELS),
			       &value), REG_OK);
	zassert_equal(value.u16, 2U);
	zassert_equal(reg_read(REG_VC_ID(0, REG_VC_FIELD_CFG_TARGET_VOLTAGE),
			       &value), REG_OK);
	zassert_equal(value.s16, 5000);
}

ZTEST(vc_api, test_catalog_write_is_validated_and_committed_by_vc_owner)
{
	union reg_value value = { .s16 = 3200 };

	zassert_equal(reg_write(REG_VC_ID(0, REG_VC_FIELD_CFG_TARGET_VOLTAGE),
				value, K_SECONDS(1)), REG_OK);
	zassert_equal(reg_read(REG_VC_ID(0, REG_VC_FIELD_CFG_TARGET_VOLTAGE),
			       &value), REG_OK);
	zassert_equal(value.s16, 3200);

	value.s16 = 21000;
	zassert_equal(reg_write(REG_VC_ID(0, REG_VC_FIELD_CFG_TARGET_VOLTAGE),
				value, K_SECONDS(1)), REG_INVALID_VALUE);
	zassert_equal(reg_read(REG_VC_ID(0, REG_VC_FIELD_CFG_TARGET_VOLTAGE),
			       &value), REG_OK);
	zassert_equal(value.s16, 3200);
}

ZTEST(vc_api, test_plain_scalars_are_bound_to_canonical_storage)
{
	const struct reg_descriptor *target = reg_describe(
		REG_VC_ID(0, REG_VC_FIELD_CFG_TARGET_VOLTAGE));
	const struct reg_descriptor *status = reg_describe(
		REG_VC_ID(0, REG_VC_FIELD_STATUS_BITS));

	zassert_not_null(target);
	zassert_not_null(target->value);
	zassert_not_null(status);
	zassert_not_null(status->value);
}

ZTEST(vc_api, test_read_observes_state_after_command_completion)
{
	write_u16(REG_VC_ID(1, REG_VC_FIELD_CFG_TARGET_VOLTAGE), 4100);
	zassert_equal(read_u16(REG_VC_ID(1, REG_VC_FIELD_CFG_TARGET_VOLTAGE)),
		4100);
}

ZTEST(vc_api, test_catalog_command_routes_through_runtime)
{
	union reg_value value = { .u16 = VC_OUTPUT_ACTION_ENABLE };

	zassert_equal(reg_write(REG_VC_ID(0, REG_VC_FIELD_OUTPUT_ACTION),
				value, K_SECONDS(1)), REG_OK);
	k_msleep(20);
	zassert_equal(reg_read(REG_VC_ID(0, REG_VC_FIELD_STATUS_BITS), &value),
		      REG_OK);
	zassert_true(value.u16 & 0x0002);

	value.u16 = VC_OUTPUT_ACTION_DISABLE_IMMEDIATE;
	zassert_equal(reg_write(REG_VC_ID(0, REG_VC_FIELD_OUTPUT_ACTION),
				value, K_SECONDS(1)), REG_OK);
}

ZTEST(vc_api, test_catalog_dispatches_calibration)
{
	write_u16(REG_VC_GLOBAL_ID(REG_VC_GLOBAL_FIELD_CAL_UNLOCK),
		  CAL_UNLOCK_STEP1);
	write_u16(REG_VC_GLOBAL_ID(REG_VC_GLOBAL_FIELD_CAL_UNLOCK),
		  CAL_UNLOCK_STEP2);
	write_u16(REG_VC_GLOBAL_ID(REG_VC_GLOBAL_FIELD_OPERATING_MODE),
		  VC_OPERATING_MODE_CALIBRATION);

	k_msleep(50);
	zassert_equal(read_u16(REG_VC_GLOBAL_ID(
		REG_VC_GLOBAL_FIELD_ACTIVE_OPERATING_MODE)),
		VC_OPERATING_MODE_CALIBRATION);

	write_u16(REG_VC_GLOBAL_ID(REG_VC_GLOBAL_FIELD_OPERATING_MODE),
		  VC_OPERATING_MODE_NORMAL);
}

ZTEST(vc_api, test_catalog_reads_supported_channel_count)
{
	zassert_equal(read_u16(REG_VC_GLOBAL_ID(
		REG_VC_GLOBAL_FIELD_SUPPORTED_CHANNELS)), 2);
}
```

## src/vc_channel_stub.c
```c
/*
 * Copyright (c) 2026 Jianwei
 *
 * SPDX-License-Identifier: Apache-2.0
 */

#include <zephyr/device.h>
#include <zephyr/devicetree.h>

#define DT_DRV_COMPAT jianwei_vc_channel_stub

static int vc_channel_stub_init(const struct device *dev)
{
	ARG_UNUSED(dev);
	return 0;
}

#define VC_CHANNEL_STUB_DEFINE(inst) \
	DEVICE_DT_INST_DEFINE(inst, vc_channel_stub_init, NULL, \
			      NULL, NULL, POST_KERNEL, \
			      CONFIG_KERNEL_INIT_PRIORITY_DEVICE, NULL);

DT_INST_FOREACH_STATUS_OKAY(VC_CHANNEL_STUB_DEFINE)
```
