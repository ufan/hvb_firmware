## lib/sys_status/Kconfig
```kconfig
# SPDX-License-Identifier: Apache-2.0

config SYS_RESET
	bool "System reset service"
	depends on REBOOT
	default n
	help
	  Provide a delayed system-level cold-reset request service.

config SYS_RESET_DELAY_MS
	int "System reset response-drain delay (ms)"
	depends on SYS_RESET
	default 250
	range 1 5000
	help
	  Delay before rebooting so the requesting frontend can finish its
	  response.

config SYS_STATUS
	bool "System status module (heartbeat, environment sensor)"
	default n
	help
	  Self-contained module: SYS_RUN heartbeat LED, SHT3x temp/humidity.
	  Initialized via SYS_INIT, runs its own thread. Uptime and firmware
	  version have no hardware dependency and are always available
	  regardless of this option — see sys_uptime.c.

if SYS_STATUS

config SYS_STATUS_HEARTBEAT_INTERVAL_MS
	int "Heartbeat LED toggle interval (ms)"
	default 500
	range 100 5000
	help
	  Interval in milliseconds between SYS_RUN LED toggles.

config SYS_STATUS_SENSOR_INTERVAL_MS
	int "Temperature/humidity sensor poll interval (ms)"
	default 1000
	range 500 60000
	help
	  Interval in milliseconds between SHT3x sensor reads.

config SYS_STATUS_THREAD_STACK_SIZE
	int "sys_status thread stack size"
	default 1024
	range 512 4096
	help
	  Stack size in bytes for the sys_status worker thread.

config SYS_STATUS_THREAD_PRIORITY
	int "sys_status thread priority"
	default 7
	range 1 15
	help
	  Zephyr thread priority for the sys_status worker.

endif # SYS_STATUS

config SYS_STATUS_SHELL
	bool "Shell commands for system status"
	default n
	select SHELL
	help
	  Enable "ss" shell command to display uptime and firmware version.
	  Also shows board temperature/humidity when CONFIG_SYS_STATUS is
	  enabled. Does not depend on CONFIG_SYS_STATUS itself.
```

## lib/voltage_control/Kconfig
```kconfig
# SPDX-License-Identifier: Apache-2.0

config VC_DEFAULT_OPERATING_MODE
	int "Factory-default boot operating mode"
	default 0
	range 0 2
	help
	  Factory default for vc_system_config.operating_mode (0=NORMAL,
	  1=AUTOMATIC, 2=CALIBRATION), used before any NVS-persisted system
	  config is loaded. Boards whose channels rely on the AUTOMATIC-mode
	  enable-all invariant to reach their startup state (e.g. jw_lvb,
	  where every channel is a fixed-voltage output with no other startup
	  path — see configured_output_enabled) override this to 1.

config VC_VARIANT_ID
	int "Voltage-control variant identifier reported over Modbus"
	default 1
	range 1 255
	help
	  Numeric identifier for the hardware variant (1 = HVB, 2 = LVB).
	  Reported in the VARIANT_ID Modbus register so host tools can adapt
	  their behaviour to the connected board type.

config VC_CURRENT_UNIT_EXP
	int "Decimal exponent for the current-measurement register unit"
	default -10
	range -15 0
	help
	  MEASURED_CURRENT and CURRENT_LIMIT_THRESHOLD are raw int16 registers
	  whose physical unit is 10^VC_CURRENT_UNIT_EXP amperes per LSB.
	  Reported in the CURRENT_UNIT_EXP Modbus register so host tools know
	  how to interpret them, instead of assuming a fixed unit for every
	  variant. This is board-specific because a single fixed unit can't
	  span both nA-scale sense currents and amp-scale load currents in an
	  int16 (max representable magnitude is 32767 * 10^exp amperes) — the
	  calibration gain (measured_current_calib_k/_exp) only controls the
	  raw-ADC-to-register conversion, not what physical unit the resulting
	  register value is declared to mean. Default -10 (0.1 nA/LSB)
	  preserves the value every board used before this option existed.
	  Voltage has no equivalent — every variant uses a fixed 0.1V/LSB.

config VC_CHANNEL_CONTROLLER
	bool "VC channel controller DTS aggregation"
	default y
	depends on DT_HAS_JIANWEI_VC_CONTROLLER_ENABLED
	help
	  Enable compile-time channel construction from the
	  jianwei,vc-controller DTS node.

config VC_RUNTIME
	bool "VC runtime service"
	select SMF
	help
	  Enable the voltage-control runtime service.

config VC_RUNTIME_COMMAND_QUEUE_DEPTH
	int "VC runtime command queue depth"
	default 8
	range 1 64
	depends on VC_RUNTIME
	help
	  Maximum number of queued runtime commands.

config VC_RUNTIME_THREAD_STACK_SIZE
	int "VC runtime worker stack size"
	default 2048
	range 1024 8192
	depends on VC_RUNTIME
	help
	  Stack size in bytes for the voltage-control runtime worker.

config VC_RUNTIME_THREAD_PRIORITY
	int "VC runtime worker priority"
	default 5
	range 1 15
	depends on VC_RUNTIME
	help
	  Zephyr thread priority for the voltage-control runtime worker.

config VC_RUNTIME_TICK_INTERVAL_MS
	int "VC runtime policy tick interval"
	default 100
	range 1 60000
	depends on VC_RUNTIME
	help
	  Runtime policy tick interval in milliseconds.

config VC_CAL_SAMPLE_TIMEOUT_MS
	int "VC calibration sample freshness timeout"
	default 1000
	range 1 60000
	depends on VC_RUNTIME
	help
	  Upper bound in milliseconds for "vc cal sample" to wait for a
	  measurement newer than the one already cached, so the reported
	  raw ADC value reflects the DAC code just written rather than a
	  stale reading from before it. Must comfortably exceed the
	  hardware's worst-case conversion cycle. If no fresher sample
	  arrives within this window, the latest available reading is
	  returned anyway.

config VC_CAL_MAX_RAW_DAC
	int "Calibration DAC ceiling (raw counts)"
	default 65535
	range 1 65535
	help
	  Absolute upper bound for the calibration DAC code, set by the hardware
	  DAC resolution. Applied at build time; not adjustable at runtime.
	  65535 = full 16-bit range.

config VC_DEFAULT_OUTPUT_CAL_K
	int "Default output calibration gain mantissa (unity = 10000 at exp=-4)"
	default 32768
	range 1 65535
	help
	  Factory default for output_calib_k. The DAC drive formula is
	  raw = target * k * 10^k_exp + b (see VC_DEFAULT_OUTPUT_CAL_K_EXP).
	  At k=32768, exp=-4 a target of 20000 (2000 V) maps to DAC code
	  65536, filling the full 16-bit range — this is the legacy
	  raw = (target × k) / 10000 + b formula, unchanged.

config VC_DEFAULT_OUTPUT_CAL_K_EXP
	int "Default output calibration gain decimal exponent"
	default -4
	range -9 4
	help
	  Decimal exponent paired with VC_DEFAULT_OUTPUT_CAL_K: gain =
	  k * 10^k_exp. Default -4 reproduces the legacy fixed /10000
	  divisor exactly. A board whose max output voltage is much lower
	  than 2000 V (less analog gain headroom before the DAC saturates)
	  needs a larger effective gain than k alone can represent in
	  uint16_t — raise k_exp instead of trying to push k past 65535.

config VC_DEFAULT_MEASURED_V_CAL_K
	int "Default measured-voltage calibration gain mantissa (unity = 1000000 at exp=-6)"
	default 1
	range 1 65535
	help
	  Factory default for measured_voltage_calib_k, applied before a real
	  per-unit calibration is loaded. The gain is
	  raw_adc * k * 10^k_exp (see VC_DEFAULT_MEASURED_V_CAL_K_EXP). The
	  default k=1 at the default exp=-6 yields an intentionally
	  negligible reading until the board is calibrated. Unlike the old
	  fixed-divisor format, gain here is not limited to sub-unity —
	  raise k_exp for a board whose measurement front-end amplifies
	  rather than attenuates (e.g. no resistive divider ahead of the ADC).

config VC_DEFAULT_MEASURED_V_CAL_K_EXP
	int "Default measured-voltage calibration gain decimal exponent"
	default -6
	range -9 4
	help
	  Decimal exponent paired with VC_DEFAULT_MEASURED_V_CAL_K: gain =
	  k * 10^k_exp. Default -6 reproduces the legacy fixed /1000000
	  divisor exactly.

config VC_DEFAULT_MEASURED_I_CAL_K
	int "Default measured-current calibration gain mantissa (unity = 1000000 at exp=-6)"
	default 1
	range 1 65535
	help
	  Factory default for measured_current_calib_k, applied before a real
	  per-unit calibration is loaded. The gain is
	  raw_adc * k * 10^k_exp (see VC_DEFAULT_MEASURED_I_CAL_K_EXP). The
	  default k=1 at the default exp=-6 yields an intentionally
	  negligible reading until the board is calibrated. Unlike the old
	  fixed-divisor format, gain here is not limited to sub-unity —
	  raise k_exp for a board whose measurement front-end amplifies
	  rather than attenuates.

config VC_DEFAULT_MEASURED_I_CAL_K_EXP
	int "Default measured-current calibration gain decimal exponent"
	default -6
	range -9 4
	help
	  Decimal exponent paired with VC_DEFAULT_MEASURED_I_CAL_K: gain =
	  k * 10^k_exp. Default -6 reproduces the legacy fixed /1000000
	  divisor exactly.

config VC_MAX_TARGET_VOLTAGE
	int "Maximum configurable target voltage (×100 mV)"
	default 20000
	range 1 32767
	help
	  Upper bound accepted for the per-channel configured_target_voltage field
	  in normal and automatic modes. Unit is ×100 mV (e.g. 20000 = 2000 V).
	  The field is signed 16-bit so 32767 is the absolute type ceiling.

config VC_DEFAULT_CURRENT_LIMIT
	int "Default current limit threshold (raw, x0.1 nA/LSB)"
	default 10000
	range 1 32767
	help
	  Factory default for the per-channel current_limit_threshold field.
	  Unit is x0.1 nA per LSB, the same convention as measured_current
	  (see docs/guide/parameter-reference.md). Default 10000 = 1000 nA
	  (1 uA). The field is signed 16-bit, so 32767 (3276.7 nA) is the
	  absolute ceiling.

config VC_DEFAULT_RAMP_STEP
	int "Default output ramp step size"
	default 150
	range 1 65535
	help
	  Factory default for ramp_up_step and ramp_down_step. Unit matches the
	  configured_target_voltage field (×100 mV per ramp interval).

config VC_DEFAULT_OUTPUT_ENABLED
	bool "Default startup output state for fixed-voltage channels"
	default n
	help
	  Factory default for configured_output_enabled, the AUTOMATIC-mode/
	  startup desired-on-off state used by channels without
	  CH_CAP_RAW_OUTPUT_DRIVE (which have no target voltage to gate on
	  instead). Off by default, matching the conservative
	  disabled-until-configured precedent used for configured_target_voltage;
	  boards whose reference hardware powers all channels up by default
	  (e.g. jw_lvb) override this to y.

config VC_DEFAULT_CURRENT_SAFE_BAND_PCT
	int "Default current safe-band percentage"
	default 10
	range 0 100
	help
	  Factory default for current_safe_band_pct. Current protection is
	  suppressed while the output is within this percentage of the limit,
	  to avoid false trips during normal transients.

config VC_MAX_RETRY_HISTORY
	int "Max tracked auto-retry attempts per channel"
	default 8
	range 1 32
	help
	  Size of the fixed-size ring buffer used for the auto-retry sliding
	  window (Auto Retry Window / Auto Retry Max Count). auto_retry_max_count
	  writes above this value are rejected -- there is no dynamic allocation
	  in the domain layer, so this is a hard ceiling, not a soft default.

config VC_CAL_WATCHDOG_TIMEOUT_S
	int "VC calibration inactivity watchdog timeout"
	default 300
	range 1 3600
	help
	  Time in seconds before inactive calibration mode automatically exits.

config VC_SETTINGS_PERSISTENCE
	bool "VC settings persistence via NVS"
	depends on VC_RUNTIME
	select SETTINGS
	select NVS
	select FLASH
	select FLASH_MAP
	help
	  Enable save/load/factory-reset of system and channel configs
	  using Zephyr Settings backed by NVS on internal flash.

config VC_SHELL
	bool "Zephyr shell adapter for voltage-control"
	default n
	depends on VC_RUNTIME
	select SHELL
	# Boards with no debug UART (e.g. jw_lvb) select SHELL_BACKEND_RTT
	# themselves in their app board .conf instead; don't force the serial
	# backend on top of that.
	select SHELL_BACKEND_SERIAL if !SHELL_BACKEND_RTT
	help
	  Enable interactive shell commands under the "vc" top-level
	  command for controlling and monitoring the voltage-control
	  system.

if VC_SHELL

config VC_SHELL_WATCH_DEFAULT_INTERVAL_MS
	int "Default watch interval (ms)"
	default 1000
	range 100 10000
	help
	  Default polling interval in milliseconds for the vc watch command.

endif # VC_SHELL
```

## tests/drivers/ads1232/testcase.yaml
```yaml
tests:
  drivers.ads1232:
    platform_allow: native_sim
    tags:
      - adc
      - drivers
```

## tests/voltage_control/domain/testcase.yaml
```yaml
tests:
  voltage_control.domain:
    platform_allow: native_posix
    tags: voltage_control
```

## tests/voltage_control/modbus_adapter/testcase.yaml
```yaml
tests:
  voltage_control.modbus_adapter:
    platform_allow: native_posix
  voltage_control.modbus_adapter.settings:
    extra_args: OVERLAY_CONFIG=prj_settings.conf
    platform_allow: native_posix
```

## tests/voltage_control/reg_store/testcase.yaml
```yaml
tests:
  voltage_control.reg_store:
    platform_allow: native_posix
  voltage_control.reg_store_16ch:
    platform_allow: native_posix
    extra_args:
      - EXTRA_DTC_OVERLAY_FILE=boards/native_posix_16.overlay
    extra_configs:
      - CONFIG_VC_RUNTIME=y
      - CONFIG_VC_RUNTIME_COMMAND_QUEUE_DEPTH=2
      - CONFIG_VC_RUNTIME_THREAD_STACK_SIZE=2048
      - CONFIG_VC_RUNTIME_THREAD_PRIORITY=5
      - CONFIG_VC_RUNTIME_TICK_INTERVAL_MS=1000
```

## tests/voltage_control/vc_channel_state/testcase.yaml
```yaml
tests:
  voltage_control.vc_channel_state:
    platform_allow: native_posix
    tags: voltage_control
```

## tests/voltage_control/vc_controller/testcase.yaml
```yaml
tests:
  voltage_control.vc_controller:
    platform_allow: native_posix
    tags: voltage_control
```

## west.yml
```yaml
# SPDX-License-Identifier: Apache-2.0

manifest:
  remotes:
    - name: zephyrproject-rtos
      url-base: https://github.com/zephyrproject-rtos

  projects:
    - name: zephyr
      remote: zephyrproject-rtos
      revision: v3.7.2
      import:
        # By using name-allowlist we can clone only the modules that are
        # strictly needed by the application.
        name-allowlist:
          - mcuboot
          - cmsis      # required by the ARM port
          - hal_stm32  # required by the jw_hvb board (STM32 based)
          - segger     # required by RTT viewer
```
